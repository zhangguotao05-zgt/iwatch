## firmware/boards/iwatch_sf32lb58_a128_qspi/lcpu/Kconfig.board
```kconfig
config BSP_USING_BOARD_IWATCH_SF32LB58_A128_QSPI
    bool
    select SOC_SF32LB58X
    select BF0_LCPU
    default y

rsource "../Kconfig.board"
```
